## apps/firmware/yocto/meta-firmware/conf/layer.conf
```bitbake
BBPATH .= ":${LAYERDIR}"
BBFILES += "${LAYERDIR}/recipes-*/*/*.bb \
            ${LAYERDIR}/recipes-*/*/*.bbappend"

BBFILE_COLLECTIONS += "firmware"
BBFILE_PATTERN_firmware = "^${LAYERDIR}/"
BBFILE_PRIORITY_firmware = "10"

LAYERDEPENDS_firmware = "core raspberrypi"
LAYERSERIES_COMPAT_firmware = "wrynose"
```
